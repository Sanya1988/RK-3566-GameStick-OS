## br2-external/Config.in
```kconfig
menu "Gamestick packages"

source "$BR2_EXTERNAL_GAMESTICK_PATH/package/gamestick-freeimage/Config.in"
source "$BR2_EXTERNAL_GAMESTICK_PATH/package/gamestick-bios/Config.in"
source "$BR2_EXTERNAL_GAMESTICK_PATH/package/gamestick-esde/Config.in"
source "$BR2_EXTERNAL_GAMESTICK_PATH/package/gamestick-games-storage/Config.in"
source "$BR2_EXTERNAL_GAMESTICK_PATH/package/gamestick-input/Config.in"
source "$BR2_EXTERNAL_GAMESTICK_PATH/package/gamestick-libudev-zero/Config.in"
source "$BR2_EXTERNAL_GAMESTICK_PATH/package/gamestick-libretro-cores-r1/Config.in"
source "$BR2_EXTERNAL_GAMESTICK_PATH/package/gamestick-mali-g52/Config.in"
source "$BR2_EXTERNAL_GAMESTICK_PATH/package/gamestick-mali-r25p0-wayland-runtime/Config.in"
source "$BR2_EXTERNAL_GAMESTICK_PATH/package/gamestick-retroarch-assets/Config.in"
source "$BR2_EXTERNAL_GAMESTICK_PATH/package/gamestick-retroarch/Config.in"

endmenu
```

## br2-external/configs/gamestick_rk3566_m16_defconfig
```kconfig
BR2_aarch64=y
BR2_cortex_a55=y
BR2_TOOLCHAIN_EXTERNAL=y
BR2_TOOLCHAIN_EXTERNAL_BOOTLIN=y
BR2_TOOLCHAIN_EXTERNAL_BOOTLIN_AARCH64_GLIBC_STABLE=y
BR2_ENABLE_LOCALE=y
# BR2_ENABLE_LOCALE_PURGE is not set
BR2_GENERATE_LOCALE="en_US en_GB ru_RU ar_SA bs_BA ca_ES de_DE es_ES fr_FR hr_HR it_IT ja_JP ko_KR nl_NL pl_PL pt_BR pt_PT ro_RO sr_RS sv_SE zh_CN zh_TW"

BR2_TARGET_GENERIC_HOSTNAME="gamestick-os"
BR2_TARGET_GENERIC_ISSUE="GameStick OS"
BR2_DL_DIR="$(CONFIG_DIR)/dl"
BR2_TARGET_ENABLE_ROOT_LOGIN=y
BR2_TARGET_GENERIC_ROOT_PASSWD="root"
BR2_TARGET_GENERIC_GETTY=y
BR2_TARGET_GENERIC_GETTY_PORT="ttyS2"
BR2_TARGET_GENERIC_GETTY_BAUDRATE_KEEP=y
BR2_TARGET_GENERIC_GETTY_TERM="vt100"
BR2_ROOTFS_DEVICE_CREATION_DYNAMIC_DEVTMPFS=y
BR2_ROOTFS_POST_BUILD_SCRIPT="$(BR2_EXTERNAL_GAMESTICK_PATH)/board/rk3566-m16/post-build.sh"
BR2_ROOTFS_POST_IMAGE_SCRIPT="$(BR2_EXTERNAL_GAMESTICK_PATH)/board/rk3566-m16/post-image.sh"

BR2_LINUX_KERNEL=y
BR2_LINUX_KERNEL_CUSTOM_GIT=y
BR2_LINUX_KERNEL_CUSTOM_REPO_URL="https://github.com/rockchip-linux/kernel.git"
BR2_LINUX_KERNEL_CUSTOM_REPO_VERSION="ac1ada90c9edf815f4eddb9bea4a7ad4283a6189"
BR2_LINUX_KERNEL_USE_DEFCONFIG=y
BR2_LINUX_KERNEL_DEFCONFIG="rockchip_linux"
BR2_LINUX_KERNEL_CONFIG_FRAGMENT_FILES="$(BR2_EXTERNAL_GAMESTICK_PATH)/board/rk3566-m16/kernel-bsp.fragment"
BR2_LINUX_KERNEL_DTS_SUPPORT=y
BR2_LINUX_KERNEL_INTREE_DTS_NAME="rockchip/m_16_boot"
BR2_LINUX_KERNEL_CUSTOM_DTS_DIR="$(BR2_EXTERNAL_GAMESTICK_PATH)/board/rk3566-m16/linux-dts"
BR2_LINUX_KERNEL_DTB_KEEP_DIRNAME=y
BR2_LINUX_KERNEL_INSTALL_TARGET=y

BR2_PACKAGE_ROCKCHIP_RKBIN=y
BR2_PACKAGE_ROCKCHIP_RKBIN_TPL_FILENAME="bin/rk35/rk3566_ddr_1056MHz_v1.23.bin"

BR2_TARGET_ARM_TRUSTED_FIRMWARE=y
BR2_TARGET_ARM_TRUSTED_FIRMWARE_CUSTOM_VERSION=y
BR2_TARGET_ARM_TRUSTED_FIRMWARE_CUSTOM_VERSION_VALUE="lts-v2.12.1"
BR2_TARGET_ARM_TRUSTED_FIRMWARE_PLATFORM="rk3568"
BR2_TARGET_ARM_TRUSTED_FIRMWARE_IMAGES="bl31/bl31.elf"

BR2_TARGET_UBOOT=y
BR2_TARGET_UBOOT_BUILD_SYSTEM_KCONFIG=y
BR2_TARGET_UBOOT_CUSTOM_VERSION=y
BR2_TARGET_UBOOT_CUSTOM_VERSION_VALUE="2026.01"
BR2_TARGET_UBOOT_BOARD_DEFCONFIG="generic-rk3568"
BR2_TARGET_UBOOT_NEEDS_PYLIBFDT=y
BR2_TARGET_UBOOT_NEEDS_PYELFTOOLS=y
BR2_TARGET_UBOOT_NEEDS_OPENSSL=y
BR2_TARGET_UBOOT_NEEDS_GNUTLS=y
BR2_TARGET_UBOOT_NEEDS_ATF_BL31=y
BR2_TARGET_UBOOT_NEEDS_ATF_BL31_ELF=y
BR2_TARGET_UBOOT_NEEDS_ROCKCHIP_RKBIN=y

BR2_TARGET_ROOTFS_EXT2=y
BR2_TARGET_ROOTFS_EXT2_4=y
BR2_TARGET_ROOTFS_EXT2_LABEL="rootfs"
BR2_TARGET_ROOTFS_EXT2_SIZE="1024M"
BR2_TARGET_ROOTFS_EXT2_MKFS_OPTIONS="-O ^orphan_file"
# BR2_TARGET_ROOTFS_TAR is not set

BR2_PACKAGE_ALSA_UTILS=y
BR2_PACKAGE_ALSA_UTILS_ALSACTL=y
BR2_PACKAGE_ALSA_UTILS_AMIXER=y
BR2_PACKAGE_ALSA_UTILS_APLAY=y
BR2_PACKAGE_ALSA_UTILS_SPEAKER_TEST=y
BR2_PACKAGE_FBV=y
BR2_PACKAGE_PSPLASH=y
BR2_PACKAGE_PSPLASH_IMAGE="$(BR2_EXTERNAL_GAMESTICK_PATH)/board/rk3566-m16/boot-splash.png"
# BR2_PACKAGE_PSPLASH_PROGRESS_BAR is not set
# BR2_PACKAGE_PSPLASH_STARTUP_MSG is not set
BR2_PACKAGE_PSPLASH_FULL_SCREEN=y
BR2_PACKAGE_SDL2=y
BR2_PACKAGE_SDL2_KMSDRM=y
BR2_PACKAGE_SDL2_OPENGLES=y

BR2_PACKAGE_HOST_GENIMAGE=y

BR2_PACKAGE_GAMESTICK_GAMES_STORAGE=y
BR2_PACKAGE_GAMESTICK_RETROARCH=y
BR2_PACKAGE_GAMESTICK_ESDE=y
BR2_PACKAGE_ROCKCHIP_MALI=y
```

## br2-external/package/gamestick-bios/Config.in
```kconfig
config BR2_PACKAGE_GAMESTICK_BIOS
	bool "gamestick-bios"
	help
	  Curated BIOS and firmware seed for the currently supported
	  GameStick RetroArch core set.
```

## br2-external/package/gamestick-esde/Config.in
```kconfig
config BR2_PACKAGE_GAMESTICK_ESDE
	bool "gamestick-esde"
	depends on BR2_TOOLCHAIN_USES_GLIBC
	depends on BR2_INSTALL_LIBSTDCPP
	depends on BR2_TOOLCHAIN_HAS_THREADS
	depends on !BR2_STATIC_LIBS
	depends on BR2_PACKAGE_HAS_LIBEGL
	depends on BR2_PACKAGE_HAS_LIBGLES
	depends on BR2_PACKAGE_GAMESTICK_RETROARCH
	select BR2_PACKAGE_ALSA_LIB
	select BR2_PACKAGE_FFMPEG
	select BR2_PACKAGE_FREETYPE
	select BR2_PACKAGE_GAMESTICK_FREEIMAGE
	select BR2_PACKAGE_HARFBUZZ
	select BR2_PACKAGE_ICU
	select BR2_PACKAGE_POPPLER
	select BR2_PACKAGE_PUGIXML
	select BR2_PACKAGE_SDL2
	help
	  ES-DE frontend integrated against the bundled esde source tree,
	  configured for offline GameStick use and RetroArch launching.

comment "gamestick-esde needs EGL/GLES, glibc, C++, threads and shared libs"
	depends on !BR2_PACKAGE_HAS_LIBEGL || !BR2_PACKAGE_HAS_LIBGLES || !BR2_PACKAGE_GAMESTICK_RETROARCH || !(BR2_TOOLCHAIN_USES_GLIBC && BR2_INSTALL_LIBSTDCPP && BR2_TOOLCHAIN_HAS_THREADS) || BR2_STATIC_LIBS
```

## br2-external/package/gamestick-freeimage/Config.in
```kconfig
config BR2_PACKAGE_GAMESTICK_FREEIMAGE
	bool "gamestick-freeimage"
	depends on BR2_INSTALL_LIBSTDCPP
	depends on !BR2_STATIC_LIBS
	help
	  FreeImage library packaged locally for ES-DE.

comment "gamestick-freeimage needs a toolchain with C++ and shared libs"
	depends on !BR2_INSTALL_LIBSTDCPP || BR2_STATIC_LIBS
```

## br2-external/package/gamestick-games-storage/Config.in
```kconfig
config BR2_PACKAGE_GAMESTICK_GAMES_STORAGE
	bool "gamestick-games-storage"
	select BR2_PACKAGE_EXFAT
	select BR2_PACKAGE_EXFATPROGS
	select BR2_PACKAGE_NTFS_3G
	select BR2_PACKAGE_UTIL_LINUX
	select BR2_PACKAGE_UTIL_LINUX_BINARIES
	help
	  Mount the userdata partition labeled USERDATA at /storage during boot,
	  preferring exFAT and keeping NTFS compatibility for older cards,
	  and prepare persistent directories for ROMs and frontend data.
```

## br2-external/package/gamestick-input/Config.in
```kconfig
config BR2_PACKAGE_GAMESTICK_INPUT
	bool "gamestick-input"
	help
	  Lightweight controller subsystem for GameStick OS.

	  Imports the Batocera controller database, generates RetroArch
	  autoconfig profiles and SDL controller mappings at build time,
	  and installs a small runtime refresh/logging layer with support
	  for user overrides.
```

## br2-external/package/gamestick-libretro-cores-r1/Config.in
```kconfig
config BR2_PACKAGE_GAMESTICK_LIBRETRO_CORES_R1
	bool "gamestick-libretro-cores-r1"
	help
	  Curated RK3566 libretro core set built from pinned source
	  revisions during the Buildroot package build.
```

## br2-external/package/gamestick-libudev-zero/Config.in
```kconfig
config BR2_PACKAGE_GAMESTICK_LIBUDEV_ZERO
	bool "gamestick-libudev-zero"
	depends on BR2_TOOLCHAIN_USES_GLIBC
	depends on !BR2_STATIC_LIBS
	help
	  Minimal libudev-compatible userspace library used to build and run
	  RetroArch udev input/joypad backends without requiring full eudev.
```

## br2-external/package/gamestick-mali-g52/Config.in
```kconfig
config BR2_PACKAGE_GAMESTICK_MALI_G52
	bool "gamestick-mali-g52"
	depends on BR2_aarch64
	select BR2_PACKAGE_LIBDRM
	select BR2_PACKAGE_LIBGLVND
	select BR2_PACKAGE_WAYLAND
	select BR2_PACKAGE_HAS_LIBEGL
	select BR2_PACKAGE_HAS_LIBGLES
	select BR2_PACKAGE_HAS_LIBGBM
	select BR2_PACKAGE_LIBGBM_HAS_FEATURE_DMA_BUF
	select BR2_PACKAGE_LIBGBM_HAS_FEATURE_FORMAT_MODIFIER_PLANE_COUNT
	help
	  Install the proprietary Mali G52 userspace stack used as the
	  current compatibility target for GameStick M16 runtime bring-up.

if BR2_PACKAGE_GAMESTICK_MALI_G52

config BR2_PACKAGE_PROVIDES_LIBEGL
	default "gamestick-mali-g52"

config BR2_PACKAGE_PROVIDES_LIBGLES
	default "gamestick-mali-g52"

config BR2_PACKAGE_PROVIDES_LIBGBM
	default "gamestick-mali-g52"

endif

comment "gamestick-mali-g52 needs aarch64"
	depends on !BR2_aarch64
```

## br2-external/package/gamestick-mali-r25p0-wayland-runtime/Config.in
```kconfig
config BR2_PACKAGE_GAMESTICK_MALI_R25P0_WAYLAND_RUNTIME
	bool "gamestick-mali-r25p0-wayland-runtime"
	depends on BR2_aarch64
	help
	  Installs the known-good Mali userspace runtime layout from the
	  earlier working GameStick baseline:
	  G52 r25p0 wayland package layout plus the minimal wayland/libffi
	  runtime libraries it required on target.
```

## br2-external/package/gamestick-retroarch-assets/Config.in
```kconfig
config BR2_PACKAGE_GAMESTICK_RETROARCH_ASSETS
	bool "gamestick-retroarch-assets"
	help
	  Minimal RetroArch asset pack for Gamestick images.
	  Installs Ozone assets plus the XMB monochrome icon set,
	  fallback fonts, GLUI assets and menu sounds.
```

## br2-external/package/gamestick-retroarch/Config.in
```kconfig
config BR2_PACKAGE_GAMESTICK_RETROARCH
	bool "gamestick-retroarch"
	depends on BR2_TOOLCHAIN_USES_GLIBC
	depends on BR2_INSTALL_LIBSTDCPP
	depends on BR2_TOOLCHAIN_HAS_THREADS
	depends on !BR2_STATIC_LIBS
	depends on BR2_aarch64 || BR2_arm
	select BR2_PACKAGE_ALSA_LIB
	select BR2_PACKAGE_FREETYPE
	select BR2_PACKAGE_GAMESTICK_BIOS
	select BR2_PACKAGE_GAMESTICK_INPUT
	select BR2_PACKAGE_GAMESTICK_LIBRETRO_CORES_R1
	select BR2_PACKAGE_GAMESTICK_LIBUDEV_ZERO
	select BR2_PACKAGE_GAMESTICK_MALI_R25P0_WAYLAND_RUNTIME
	select BR2_PACKAGE_GAMESTICK_RETROARCH_ASSETS
	select BR2_PACKAGE_ROCKCHIP_MALI
	select BR2_PACKAGE_ZLIB
	help
	  RetroArch frontend configured for RK3566 console use through
	  KMS/EGL/OpenGLES with ALSA audio.

comment "gamestick-retroarch needs a glibc toolchain with C++, threads and shared libs"
	depends on !(BR2_TOOLCHAIN_USES_GLIBC && BR2_INSTALL_LIBSTDCPP && BR2_TOOLCHAIN_HAS_THREADS) || BR2_STATIC_LIBS
```
